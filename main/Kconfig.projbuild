## main/Kconfig.projbuild
```kconfig
menu "Smart Silkworm Configuration"

    menu "Camera Configuration"
        config CAMERA_MIPI_CSI_SCCB_SCL
            int "SCCB I2C SCL GPIO"
            default 8
            help
                GPIO number for camera SCCB (I2C) clock line.

        config CAMERA_MIPI_CSI_SCCB_SDA
            int "SCCB I2C SDA GPIO"
            default 7
            help
                GPIO number for camera SCCB (I2C) data line.

        config CAMERA_FRAME_WIDTH
            int "Camera frame width"
            default 1280
            help
                Width of captured frames (e.g., 1280, 800, 640).

        config CAMERA_FRAME_HEIGHT
            int "Camera frame height"
            default 720
            help
                Height of captured frames (e.g., 720, 600, 480).

        config CAMERA_FRAME_RATE
            int "Camera frame rate (FPS)"
            default 15
            help
                Frames per second for video capture.
    endmenu

    menu "SD Card Configuration"
        config SD_CARD_CMD_PIN
            int "SD Card CMD pin"
            default 44

        config SD_CARD_CLK_PIN
            int "SD Card CLK pin"
            default 43

        config SD_CARD_D0_PIN
            int "SD Card D0 pin"
            default 39

        config SD_CARD_D1_PIN
            int "SD Card D1 pin"
            default 40

        config SD_CARD_D2_PIN
            int "SD Card D2 pin"
            default 41

        config SD_CARD_D3_PIN
            int "SD Card D3 pin"
            default 42

        config VIDEO_SEGMENT_DURATION_MIN
            int "Video segment duration (minutes)"
            default 30
            help
                Split recorded video into segments every N minutes.

        config VIDEO_KEEP_HOURS
            int "Keep recent video hours"
            default 24
            help
                Delete videos older than N hours to free space.
    endmenu

    menu "UART Communication"
        config UART_STM32_NUM
            int "UART port number for STM32"
            default 2
            help
                UART peripheral number (0, 1, 2).

        config UART_STM32_TX_PIN
            int "UART TX GPIO to STM32"
            default 22

        config UART_STM32_RX_PIN
            int "UART RX GPIO from STM32"
            default 21

        config UART_STM32_BAUD_RATE
            int "UART baud rate"
            default 115200
    endmenu

    menu "Network Configuration"
        config ETHERNET_PHY_ADDR
            int "Ethernet PHY address"
            default 1
            help
                PHY address on MDIO bus (usually 0 or 1).

        config ETHERNET_MDC_GPIO
            int "Ethernet MDC GPIO"
            default 31

        config ETHERNET_MDIO_GPIO
            int "Ethernet MDIO GPIO"
            default 52

        config ETHERNET_PHY_RST_GPIO
            int "Ethernet PHY reset GPIO"
            default 51
    endmenu

    menu "Logging Configuration"
        config LOG_INTERVAL_SEC
            int "Log write interval (seconds)"
            default 60
            help
                Write temperature/humidity log every N seconds.
    endmenu

endmenu
```

## sdkconfig.defaults
```kconfig
# ESP32-P4 Smart Silkworm 默认配置

# ESP32-P4 芯片版本（根据实际芯片修改）
CONFIG_ESP32P4_REV_MIN_3=y

# 以太网驱动
CONFIG_ETH_USE_ESP32_EMAC=y
CONFIG_ETH_PHY_INTERFACE_RMII=y
CONFIG_ETH_RMII_CLK_OUTPUT=y
CONFIG_ETH_RMII_CLK_OUT_GPIO=50

# Flash 配置（根据板载 Flash 大小）
CONFIG_ESPTOOLPY_FLASHSIZE_16MB=y
CONFIG_ESPTOOLPY_FLASHSIZE="16MB"

# PSRAM 配置（必需）
CONFIG_SPIRAM=y
CONFIG_SPIRAM_MODE_OCT=y
CONFIG_SPIRAM_SPEED_200M=y

# 日志级别
CONFIG_LOG_DEFAULT_LEVEL_INFO=y
CONFIG_LOG_MAXIMUM_LEVEL_DEBUG=y

# FreeRTOS
CONFIG_FREERTOS_HZ=1000
CONFIG_FREERTOS_UNICORE=n

# HTTP Server
CONFIG_HTTPD_MAX_REQ_HDR_LEN=1024
CONFIG_HTTPD_MAX_URI_LEN=512

# UART
CONFIG_UART_ISR_IN_IRAM=y

# SD Card
CONFIG_SDMMC_HOST_MAX_FREQ_HIGHSPEED=y

# 网络（以太网优先）
CONFIG_ETH_ENABLED=y

# NVS Flash
CONFIG_NVS_ENCRYPTION=n

# 分区表
CONFIG_PARTITION_TABLE_CUSTOM=y
CONFIG_PARTITION_TABLE_CUSTOM_FILENAME="partitions.csv"

# ===== 摄像头 OV5647 / MIPI-CSI =====
# 启用 esp_cam_sensor 里的 OV5647 驱动（会注册到自动探测表）
CONFIG_CAMERA_OV5647=y

# 1920x1080 RAW10：1:1 逐像素采样（无 binning），清晰度最高的模式
CONFIG_CAMERA_OV5647_MIPI_RAW10_1920X1080_30FPS=y
CONFIG_CAMERA_OV5647_MIPI_DEFAULT_FMT_RAW10_1920X1080_30FPS=y
# 格式表下标：800x800=2，1920x1080=3，1280x960 binning=4
CONFIG_CAMERA_OV5647_MIPI_IF_FORMAT_INDEX_DEFAULT=3

# 使用自定义 IPA 配置：中心测光 + 削弱 CCM + BF 按增益分档 + 提高锐化
CONFIG_CAMERA_OV5647_CUSTOMIZED_IPA_JSON_CONFIGURATION_FILE=y
CONFIG_CAMERA_OV5647_CUSTOMIZED_IPA_JSON_CONFIGURATION_FILE_PATH="config/ov5647_custom.json"

# esp_video：CSI + ISP 流水线 + 硬件 JPEG（微雪官方例程同款路径）
CONFIG_ESP_VIDEO_ENABLE_MIPI_CSI_VIDEO_DEVICE=y
CONFIG_ESP_VIDEO_ENABLE_ISP_PIPELINE_CONTROLLER=y
CONFIG_ESP_VIDEO_ENABLE_JPEG_VIDEO_DEVICE=y
```
